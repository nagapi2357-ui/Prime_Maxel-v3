/*
 * Recover Channel 0 only — proof of concept
 * Erase via register addr 0x00, write via NVM addr 0x01
 */

#include <Wire.h>

#define MUX_ADDR  0x70

const uint8_t factory_ch0[256] PROGMEM = {
  // 0x00-0x6F: all zeros
  0x00,0x00,0x00,0x00,0x00,0x00,0x00,0x00,0x00,0x00,0x00,0x00,0x00,0x00,0x00,0x00,
  0x00,0x00,0x00,0x00,0x00,0x00,0x00,0x00,0x00,0x00,0x00,0x00,0x00,0x00,0x00,0x00,
  0x00,0x00,0x00,0x00,0x00,0x00,0x00,0x00,0x00,0x00,0x00,0x00,0x00,0x00,0x00,0x00,
  0x00,0x00,0x00,0x00,0x00,0x00,0x00,0x00,0x00,0x00,0x00,0x00,0x00,0x00,0x00,0x00,
  0x00,0x00,0x00,0x00,0x00,0x00,0x00,0x00,0x00,0x00,0x00,0x00,0x00,0x00,0x00,0x00,
  0x00,0x00,0x00,0x00,0x00,0x00,0x00,0x00,0x00,0x00,0x00,0x00,0x00,0x00,0x00,0x00,
  0x00,0x00,0x00,0x00,0x00,0x00,0x00,0x00,0x00,0x00,0x00,0x00,0x00,0x00,0x00,0x00,
  // 0x70-0x7F
  0x00,0x00,0x00,0x00,0x00,0x00,0x00,0x00,0x00,0x00,0x00,0x00,0x00,0x00,0x00,0x01,
  // 0x80-0x8F
  0xA5,0x20,0x20,0x18,0x22,0xC4,0x19,0x02,0x18,0x01,0xC8,0x31,0x00,0xC0,0x08,0x00,
  // 0x90-0x9F
  0x00,0x00,0x00,0x00,0x00,0x00,0x00,0x00,0x00,0x00,0x00,0x00,0x00,0x00,0x00,0x00,
  // 0xA0-0xAF
  0x00,0x00,0x00,0x00,0x00,0x00,0x00,0x00,0x00,0x00,0x00,0x00,0x00,0x00,0x00,0x00,
  // 0xB0-0xBF
  0x00,0x00,0x00,0x00,0x00,0x00,0x00,0x00,0x00,0x00,0x00,0x00,0x00,0x00,0x00,0x00,
  // 0xC0-0xCF
  0x00,0x00,0x00,0x00,0x00,0x00,0x00,0x00,0x0F,0x48,0xF0,0x00,0x00,0x00,0x00,0x00,
  // 0xD0-0xDF
  0x00,0x00,0x00,0x00,0x00,0x00,0x00,0x00,0x00,0x00,0x00,0x00,0x00,0x02,0x08,0x86,
  // 0xE0-0xEF
  0x00,0x00,0x00,0x00,0x00,0x00,0x00,0x00,0x01,0x00,0x00,0x00,0x00,0x00,0x00,0x00,
  // 0xF0-0xFF
  0x5A,0x00,0x00,0x01,0x10,0x00,0x00,0xFF,0xFF,0x41,0x0F,0x10,0x30,0x10,0x12,0x00
};

void setup() {
  Wire.begin();
  Wire.setWireTimeout(3000, true);
  Serial.begin(9600);
  while (!Serial);
  delay(500);
  
  Serial.println(F("=== Ch 0 Recovery ==="));
  
  // Select mux ch 0
  Wire.beginTransmission(MUX_ADDR);
  Wire.write(0x01);
  Wire.endTransmission();
  delay(10);
  
  // Verify NVM responds at 0x01
  Wire.beginTransmission(0x01);
  if (Wire.endTransmission() != 0) {
    Serial.println(F("NVM at 0x01 not found! Abort."));
    return;
  }
  Serial.println(F("NVM at 0x01 found."));
  
  // Read current NVM state first
  Serial.println(F("\nCurrent NVM (page 8 = 0x80):"));
  Wire.beginTransmission(0x01);
  Wire.write(0x80);
  Wire.endTransmission();
  Wire.requestFrom((uint8_t)0x01, (uint8_t)16);
  for (int i = 0; i < 16; i++) {
    uint8_t b = Wire.available() ? Wire.read() : 0xEE;
    if (b < 0x10) Serial.print(F("0"));
    Serial.print(b, HEX);
    Serial.print(F(" "));
  }
  Serial.println();
  
  Serial.println(F("\nSend 'G' to erase+write+verify."));
  while (!Serial.available());
  if (Serial.read() != 'G') {
    Serial.println(F("Aborted."));
    return;
  }
  
  // ==== ERASE ====
  Serial.print(F("\nErasing 16 pages: "));
  for (uint8_t page = 0; page < 16; page++) {
    Wire.beginTransmission(0x00);
    Wire.write(0xE3);
    Wire.write(0xC0 | page);
    uint8_t err = Wire.endTransmission();
    Serial.print(err == 0 ? F(".") : F("X"));
    delay(50);
  }
  Serial.println();
  
  // Check if erase worked
  Serial.print(F("Post-erase page 8: "));
  Wire.beginTransmission(0x01);
  Wire.write(0x80);
  Wire.endTransmission();
  Wire.requestFrom((uint8_t)0x01, (uint8_t)16);
  bool erased = true;
  for (int i = 0; i < 16; i++) {
    uint8_t b = Wire.available() ? Wire.read() : 0xEE;
    if (b != 0x00 && b != 0xFF) erased = false;
    if (b < 0x10) Serial.print(F("0"));
    Serial.print(b, HEX);
    Serial.print(F(" "));
  }
  Serial.println();
  Serial.println(erased ? F("Erase looks good!") : F("WARNING: Erase may have failed"));
  
  // ==== WRITE ====
  Serial.print(F("\nWriting 16 pages: "));
  uint8_t buf[16];
  for (uint8_t page = 0; page < 16; page++) {
    for (uint8_t i = 0; i < 16; i++) {
      buf[i] = pgm_read_byte(&factory_ch0[page * 16 + i]);
    }
    Wire.beginTransmission(0x01);
    Wire.write(page * 16);
    for (uint8_t i = 0; i < 16; i++) {
      Wire.write(buf[i]);
    }
    uint8_t err = Wire.endTransmission();
    Serial.print(err == 0 ? F(".") : F("X"));
    delay(25);
  }
  Serial.println();
  
  // ==== VERIFY ====
  Serial.println(F("\nFull verify:"));
  int bad = 0;
  for (uint8_t page = 0; page < 16; page++) {
    Wire.beginTransmission(0x01);
    Wire.write(page * 16);
    Wire.endTransmission();
    Wire.requestFrom((uint8_t)0x01, (uint8_t)16);
    
    for (uint8_t i = 0; i < 16; i++) {
      uint8_t got = Wire.available() ? Wire.read() : 0xEE;
      uint8_t exp = pgm_read_byte(&factory_ch0[page * 16 + i]);
      if (got != exp) {
        bad++;
        if (bad <= 10) {
          Serial.print(F("  @0x"));
          Serial.print(page * 16 + i, HEX);
          Serial.print(F(": exp=0x"));
          Serial.print(exp, HEX);
          Serial.print(F(" got=0x"));
          Serial.println(got, HEX);
        }
      }
    }
  }
  
  Serial.println();
  if (bad == 0) {
    Serial.println(F("*** PERFECT VERIFY! Ch 0 RECOVERED! ***"));
    Serial.println(F("Power cycle, then run channel_scanner."));
    Serial.println(F("Ch 0 should be back at 0x08."));
  } else {
    Serial.print(bad);
    Serial.println(F(" mismatches — recovery failed."));
  }
  
  // Disable mux
  Wire.beginTransmission(MUX_ADDR);
  Wire.write(0);
  Wire.endTransmission();
}

void loop() {}
