/*
 * SLG47004V NVM Recovery — Prime_Maxel-v3
 * 
 * After accidental erase, the I2C slave addresses may have shifted.
 * This sketch scans for GreenPAKs at BOTH old (0x08) and new (0x00) 
 * base addresses, then restores the factory NVM from backup.
 * 
 * Step 1: Scan all channels at both address ranges
 * Step 2: Restore factory NVM to each chip found
 * Step 3: Reset chips to reload from NVM
 */

#include <Wire.h>

#define MUX_ADDR     0x70

// Two possible base addresses (register space)
#define GP_REG_OLD   0x08    // Factory default
#define GP_REG_NEW   0x00    // After NVM erase (SLA bits cleared)
#define GP_NVM_OLD   0x09    // Factory default NVM
#define GP_NVM_NEW   0x01    // After NVM erase

// Per-channel factory NVM backup (from dump 2026-05-16)
// Only storing the non-zero region (0x70-0xFF) — first 0x70 bytes are all zeros

const uint8_t factoryNVM_ch0[] PROGMEM = {
  // 0x70-0x7F
  0x00, 0x00, 0x00, 0x00, 0x00, 0x00, 0x00, 0x00,
  0x00, 0x00, 0x00, 0x00, 0x00, 0x00, 0x00, 0x01,
  // 0x80-0x8F
  0xA5, 0x20, 0x20, 0x18, 0x22, 0xC4, 0x19, 0x02,
  0x18, 0x01, 0xC8, 0x31, 0x00, 0xC0, 0x08, 0x00,
  // 0x90-0x9F
  0x00, 0x00, 0x00, 0x00, 0x00, 0x00, 0x00, 0x00,
  0x00, 0x00, 0x00, 0x00, 0x00, 0x00, 0x00, 0x00,
  // 0xA0-0xAF
  0x00, 0x00, 0x00, 0x00, 0x00, 0x00, 0x00, 0x00,
  0x00, 0x00, 0x00, 0x00, 0x00, 0x00, 0x00, 0x00,
  // 0xB0-0xBF
  0x00, 0x00, 0x00, 0x00, 0x00, 0x00, 0x00, 0x00,
  0x00, 0x00, 0x00, 0x00, 0x00, 0x00, 0x00, 0x00,
  // 0xC0-0xCF
  0x00, 0x00, 0x00, 0x00, 0x00, 0x00, 0x00, 0x00,
  0x0F, 0x48, 0xF0, 0x00, 0x00, 0x00, 0x00, 0x00,
  // 0xD0-0xDF
  0x00, 0x00, 0x00, 0x00, 0x00, 0x00, 0x00, 0x00,
  0x00, 0x00, 0x00, 0x00, 0x00, 0x02, 0x08, 0x86,
  // 0xE0-0xEF
  0x00, 0x00, 0x00, 0x00, 0x00, 0x00, 0x00, 0x00,
  0x01, 0x00, 0x00, 0x00, 0x00, 0x00, 0x00, 0x00,
  // 0xF0-0xFF
  0x5A, 0x00, 0x00, 0x01, 0x10, 0x00, 0x00, 0xFF,
  0xFF, 0x41, 0x0F, 0x10, 0x30, 0x10, 0x12, 0x00
};

const uint8_t factoryNVM_ch1[] PROGMEM = {
  0x00, 0x00, 0x00, 0x00, 0x00, 0x00, 0x00, 0x00,
  0x00, 0x00, 0x00, 0x00, 0x00, 0x00, 0x00, 0x01,
  0xA5, 0x22, 0x21, 0x18, 0x44, 0x00, 0x23, 0x80,
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  0xFF, 0x3E, 0x0E, 0x01, 0x30, 0x00, 0x15, 0x00
};

const uint8_t factoryNVM_ch2[] PROGMEM = {
  0x00, 0x00, 0x00, 0x00, 0x00, 0x00, 0x00, 0x00,
  0x00, 0x00, 0x00, 0x00, 0x00, 0x00, 0x00, 0x01,
  0xA5, 0x27, 0x20, 0x12, 0x06, 0x4E, 0x68, 0x80,
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  0xFF, 0x41, 0x10, 0x10, 0x30, 0x10, 0x12, 0x00
};

const uint8_t factoryNVM_ch3[] PROGMEM = {
  0x00, 0x00, 0x00, 0x00, 0x00, 0x00, 0x00, 0x00,
  0x00, 0x00, 0x00, 0x00, 0x00, 0x00, 0x00, 0x01,
  0xA5, 0x20, 0x24, 0x18, 0x42, 0x14, 0x21, 0x80,
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  0xFF, 0x40, 0x04, 0x12, 0x30, 0x00, 0x12, 0x00
};

const uint8_t factoryNVM_ch4[] PROGMEM = {
  0x00, 0x00, 0x00, 0x00, 0x00, 0x00, 0x00, 0x00,
  0x00, 0x00, 0x00, 0x00, 0x00, 0x00, 0x00, 0x01,
  0xA5, 0x29, 0x24, 0x18, 0x00, 0x0A, 0x08, 0x46,
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  0xFF, 0x40, 0x10, 0x12, 0x30, 0x06, 0x10, 0x00
};

const uint8_t factoryNVM_ch5[] PROGMEM = {
  0x00, 0x00, 0x00, 0x00, 0x00, 0x00, 0x00, 0x00,
  0x00, 0x00, 0x00, 0x00, 0x00, 0x00, 0x00, 0x01,
  0xA5, 0x28, 0x23, 0x10, 0x01, 0x20, 0x12, 0x00,
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  0xFF, 0x40, 0x10, 0x12, 0x30, 0x01, 0x10, 0x00
};

const uint8_t* factoryData[6] = {
  factoryNVM_ch0, factoryNVM_ch1, factoryNVM_ch2,
  factoryNVM_ch3, factoryNVM_ch4, factoryNVM_ch5
};

// Track which address each channel's chip is at
uint8_t chipRegAddr[6];
uint8_t chipNvmAddr[6];
bool chipFound[6];

void selectMuxChannel(uint8_t channel) {
  Wire.beginTransmission(MUX_ADDR);
  Wire.write(1 << channel);
  Wire.endTransmission();
  delay(5);
}

bool probeAddress(uint8_t addr) {
  Wire.beginTransmission(addr);
  return (Wire.endTransmission() == 0);
}

bool writeNVMPage(uint8_t nvmAddr, uint8_t startAddr, uint8_t* data, uint8_t len) {
  Wire.beginTransmission(nvmAddr);
  Wire.write(startAddr);
  for (uint8_t i = 0; i < len; i++) {
    Wire.write(data[i]);
  }
  if (Wire.endTransmission() != 0) return false;
  delay(25);  // tWR max = 20ms
  return true;
}

bool readNVMPage(uint8_t nvmAddr, uint8_t startAddr, uint8_t* buf, uint8_t len) {
  Wire.beginTransmission(nvmAddr);
  Wire.write(startAddr);
  if (Wire.endTransmission() != 0) return false;
  Wire.requestFrom(nvmAddr, len);
  for (uint8_t i = 0; i < len; i++) {
    if (Wire.available()) {
      buf[i] = Wire.read();
    } else {
      return false;
    }
  }
  return true;
}

bool eraseNVMPage(uint8_t regAddr, uint8_t page) {
  // ERSE register at 0xE3: bits[7:5]=110 (erase cmd) + bits[4:0]=page
  uint8_t cmd = 0xC0 | (page & 0x1F);
  Wire.beginTransmission(regAddr);
  Wire.write(0xE3);
  Wire.write(cmd);
  if (Wire.endTransmission() != 0) return false;
  delay(50);  // Wait for erase
  return true;
}

bool resetChip(uint8_t regAddr) {
  // Set bit 0 of register byte 0x7B (bit [984])
  Wire.beginTransmission(regAddr);
  Wire.write(0x7B);
  Wire.write(0x01);
  if (Wire.endTransmission() != 0) return false;
  delay(200);
  return true;
}

void setup() {
  Wire.begin();
  Serial.begin(9600);
  while (!Serial);
  
  Serial.println("=============================================");
  Serial.println("  SLG47004V NVM Recovery Tool");
  Serial.println("=============================================");
  Serial.println();
  
  // ===== PHASE 1: SCAN =====
  Serial.println("Phase 1: Scanning for GreenPAKs...");
  Serial.println();
  
  int totalFound = 0;
  
  for (uint8_t ch = 0; ch < 6; ch++) {
    selectMuxChannel(ch);
    chipFound[ch] = false;
    
    Serial.print("  Ch ");
    Serial.print(ch);
    Serial.print(": ");
    
    // Try old address (0x08)
    if (probeAddress(GP_REG_OLD)) {
      chipRegAddr[ch] = GP_REG_OLD;
      chipNvmAddr[ch] = GP_NVM_OLD;
      chipFound[ch] = true;
      Serial.print("found at 0x08 (factory)");
    }
    // Try new address (0x00) — use general call workaround
    else if (probeAddress(GP_REG_NEW)) {
      chipRegAddr[ch] = GP_REG_NEW;
      chipNvmAddr[ch] = GP_NVM_NEW;
      chipFound[ch] = true;
      Serial.print("found at 0x00 (shifted!)");
    }
    // Try scanning common addresses
    else {
      for (uint8_t addr = 0x01; addr < 0x78; addr++) {
        if (addr == MUX_ADDR) continue;
        if (probeAddress(addr)) {
          // First responding address might be NVM (reg+1)
          // So register addr = this - 1, or this could be register addr
          chipRegAddr[ch] = addr;
          chipNvmAddr[ch] = addr + 1;
          chipFound[ch] = true;
          Serial.print("found at 0x");
          Serial.print(addr, HEX);
          Serial.print(" (unexpected)");
          break;
        }
      }
    }
    
    if (!chipFound[ch]) {
      Serial.print("NOT FOUND");
    } else {
      totalFound++;
    }
    Serial.println();
  }
  
  // Disable mux
  Wire.beginTransmission(MUX_ADDR);
  Wire.write(0);
  Wire.endTransmission();
  
  Serial.println();
  Serial.print("  Found ");
  Serial.print(totalFound);
  Serial.println("/6 GreenPAKs");
  Serial.println();
  
  if (totalFound == 0) {
    Serial.println("No chips found! Try power cycling the board.");
    Serial.println("(Unplug USB, wait 10 sec, replug)");
    return;
  }
  
  // ===== PHASE 2: RESTORE =====
  Serial.println("Phase 2: Ready to restore factory NVM.");
  Serial.println("Send 'R' to restore, anything else to abort.");
  
  while (!Serial.available());
  char c = Serial.read();
  if (c != 'R' && c != 'r') {
    Serial.println("Aborted.");
    return;
  }
  
  Serial.println();
  Serial.println("Restoring...");
  Serial.println();
  
  int restored = 0;
  
  for (uint8_t ch = 0; ch < 6; ch++) {
    if (!chipFound[ch]) continue;
    
    selectMuxChannel(ch);
    
    Serial.print("=== Channel ");
    Serial.print(ch);
    Serial.print(" (reg=0x");
    Serial.print(chipRegAddr[ch], HEX);
    Serial.print(", nvm=0x");
    Serial.print(chipNvmAddr[ch], HEX);
    Serial.println(") ===");
    
    // Step 1: Erase all 16 NVM pages
    Serial.print("  Erasing all pages... ");
    bool eraseOK = true;
    for (uint8_t page = 0; page < 16; page++) {
      if (!eraseNVMPage(chipRegAddr[ch], page)) {
        Serial.print("FAIL@p");
        Serial.print(page);
        Serial.print(" ");
        eraseOK = false;
      }
    }
    if (eraseOK) Serial.println("OK");
    else Serial.println();
    
    // Step 2: Write factory NVM
    // First 0x70 bytes are all zeros — write them too for completeness
    Serial.print("  Writing factory NVM... ");
    
    uint8_t pageBuf[16];
    bool writeOK = true;
    
    // Pages 0-6 (0x00-0x6F): all zeros
    memset(pageBuf, 0, 16);
    for (uint8_t page = 0; page < 7; page++) {
      if (!writeNVMPage(chipNvmAddr[ch], page * 16, pageBuf, 16)) {
        writeOK = false;
        Serial.print("FAIL@p");
        Serial.print(page);
        Serial.print(" ");
      }
    }
    
    // Pages 7-15 (0x70-0xFF): from factory backup
    for (uint8_t page = 7; page < 16; page++) {
      uint8_t offset = (page - 7) * 16;  // Offset into factory data array
      for (uint8_t i = 0; i < 16; i++) {
        pageBuf[i] = pgm_read_byte(&factoryData[ch][offset + i]);
      }
      if (!writeNVMPage(chipNvmAddr[ch], page * 16, pageBuf, 16)) {
        writeOK = false;
        Serial.print("FAIL@p");
        Serial.print(page);
        Serial.print(" ");
      }
    }
    
    if (writeOK) Serial.println("OK");
    else Serial.println();
    
    // Step 3: Verify
    Serial.print("  Verifying... ");
    uint8_t verifyBuf[16];
    int mismatches = 0;
    
    // Check pages 7-15 (where the real data is)
    for (uint8_t page = 7; page < 16; page++) {
      if (!readNVMPage(chipNvmAddr[ch], page * 16, verifyBuf, 16)) {
        Serial.print("READ_FAIL@p");
        Serial.print(page);
        Serial.print(" ");
        mismatches += 16;
        continue;
      }
      uint8_t offset = (page - 7) * 16;
      for (uint8_t i = 0; i < 16; i++) {
        uint8_t expected = pgm_read_byte(&factoryData[ch][offset + i]);
        if (verifyBuf[i] != expected) {
          mismatches++;
          if (mismatches <= 3) {
            Serial.print("\n    0x");
            Serial.print(page * 16 + i, HEX);
            Serial.print(": exp=0x");
            Serial.print(expected, HEX);
            Serial.print(" got=0x");
            Serial.print(verifyBuf[i], HEX);
          }
        }
      }
    }
    
    if (mismatches == 0) {
      Serial.println("PERFECT ✓");
      restored++;
    } else {
      Serial.print("\n  FAILED — ");
      Serial.print(mismatches);
      Serial.println(" mismatches");
    }
    
    // Step 4: Reset chip
    Serial.print("  Resetting... ");
    if (resetChip(chipRegAddr[ch])) {
      Serial.println("OK");
    } else {
      Serial.println("FAIL (may need power cycle)");
    }
    
    Serial.println();
  }
  
  Wire.beginTransmission(MUX_ADDR);
  Wire.write(0);
  Wire.endTransmission();
  
  Serial.println("=============================================");
  Serial.print("  Restored: ");
  Serial.print(restored);
  Serial.print("/");
  Serial.print(totalFound);
  Serial.println(" chips");
  Serial.println("=============================================");
  Serial.println();
  Serial.println("Power cycle the board, then run channel_scanner");
  Serial.println("to verify all chips are back at 0x08-0x0B.");
}

void loop() {}
