/*
 * SLG47004V NVM Recovery v3 — Prime_Maxel-v3
 * 
 * Uses address 0x00 for register space (erase commands).
 * The chips' SLA bits got erased, shifting from 0x08→0x00.
 * Arduino Wire CAN transmit to address 0 despite it being
 * the I2C general call — the chip still responds to its address.
 */

#include <Wire.h>

#define MUX_ADDR  0x70

// Factory NVM per channel (bytes 0x70-0xFF, 144 bytes each)
const uint8_t f0[] PROGMEM = {
  0x00,0x00,0x00,0x00,0x00,0x00,0x00,0x00,0x00,0x00,0x00,0x00,0x00,0x00,0x00,0x01,
  0xA5,0x20,0x20,0x18,0x22,0xC4,0x19,0x02,0x18,0x01,0xC8,0x31,0x00,0xC0,0x08,0x00,
  0x00,0x00,0x00,0x00,0x00,0x00,0x00,0x00,0x00,0x00,0x00,0x00,0x00,0x00,0x00,0x00,
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  0x5A,0x00,0x00,0x01,0x10,0x00,0x00,0xFF,0xFF,0x41,0x0F,0x10,0x30,0x10,0x12,0x00
};
const uint8_t f1[] PROGMEM = {
  0x00,0x00,0x00,0x00,0x00,0x00,0x00,0x00,0x00,0x00,0x00,0x00,0x00,0x00,0x00,0x01,
  0xA5,0x22,0x21,0x18,0x44,0x00,0x23,0x80,0x38,0xC0,0x00,0x38,0xC0,0x80,0x60,0x31,
  0x00,0x00,0x00,0x00,0x00,0x00,0x00,0x00,0x00,0x00,0x00,0x00,0x00,0x00,0x00,0x00,
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  0x5A,0x00,0x00,0x01,0x10,0x00,0x00,0xFF,0xFF,0x3E,0x0E,0x01,0x30,0x00,0x15,0x00
};
const uint8_t f2[] PROGMEM = {
  0x00,0x00,0x00,0x00,0x00,0x00,0x00,0x00,0x00,0x00,0x00,0x00,0x00,0x00,0x00,0x01,
  0xA5,0x27,0x20,0x12,0x06,0x4E,0x68,0x80,0x10,0x04,0x08,0x30,0x00,0x3C,0xC6,0x31,
  0x00,0x00,0x00,0x00,0x00,0x00,0x00,0x00,0x00,0x00,0x00,0x00,0x00,0x00,0x00,0x00,
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  0x5A,0x00,0x00,0x01,0x10,0x00,0x00,0xFF,0xFF,0x41,0x10,0x10,0x30,0x10,0x12,0x00
};
const uint8_t f3[] PROGMEM = {
  0x00,0x00,0x00,0x00,0x00,0x00,0x00,0x00,0x00,0x00,0x00,0x00,0x00,0x00,0x00,0x01,
  0xA5,0x20,0x24,0x18,0x42,0x14,0x21,0x80,0x21,0x27,0x10,0x32,0x08,0x30,0x07,0x02,
  0x00,0x00,0x00,0x00,0x00,0x00,0x00,0x00,0x00,0x00,0x00,0x00,0x00,0x00,0x00,0x00,
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  0x5A,0x00,0x00,0x01,0x10,0x00,0x00,0xFF,0xFF,0x40,0x04,0x12,0x30,0x00,0x12,0x00
};
const uint8_t f4[] PROGMEM = {
  0x00,0x00,0x00,0x00,0x00,0x00,0x00,0x00,0x00,0x00,0x00,0x00,0x00,0x00,0x00,0x01,
  0xA5,0x29,0x24,0x18,0x00,0x0A,0x08,0x46,0x44,0x80,0xC0,0x30,0x10,0x40,0x81,0x31,
  0x00,0x00,0x00,0x00,0x00,0x00,0x00,0x00,0x00,0x00,0x00,0x00,0x00,0x00,0x00,0x00,
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  0x5A,0x00,0x00,0x01,0x10,0x00,0x00,0xFF,0xFF,0x40,0x10,0x12,0x30,0x06,0x10,0x00
};
const uint8_t f5[] PROGMEM = {
  0x00,0x00,0x00,0x00,0x00,0x00,0x00,0x00,0x00,0x00,0x00,0x00,0x00,0x00,0x00,0x01,
  0xA5,0x28,0x23,0x10,0x01,0x20,0x12,0x00,0x00,0x20,0x00,0x39,0xF0,0xAC,0x03,0x00,
  0x00,0x00,0x00,0x00,0x00,0x00,0x00,0x00,0x00,0x00,0x00,0x00,0x00,0x00,0x00,0x00,
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  0x5A,0x00,0x00,0x01,0x10,0x00,0x00,0xFF,0xFF,0x40,0x10,0x12,0x30,0x01,0x10,0x00
};

const uint8_t* fData[6] = { f0, f1, f2, f3, f4, f5 };

void selectMux(uint8_t ch) {
  Wire.beginTransmission(MUX_ADDR);
  Wire.write(1 << ch);
  Wire.endTransmission();
  delay(5);
}

void setup() {
  Wire.begin();
  Serial.begin(9600);
  while (!Serial);
  
  Serial.println(F("=== NVM Recovery v3 ==="));
  Serial.println(F("Using reg=0x00, nvm=0x01"));
  Serial.println(F("Send 'R' to erase+restore all 6 chips."));
  
  while (!Serial.available());
  if (Serial.read() != 'R') {
    Serial.println(F("Aborted."));
    return;
  }
  
  int ok = 0;
  
  for (uint8_t ch = 0; ch < 6; ch++) {
    selectMux(ch);
    
    Serial.print(F("\nCh "));
    Serial.print(ch);
    Serial.print(F(": "));
    
    // Verify chip is there (probe NVM addr 0x01)
    Wire.beginTransmission(0x01);
    if (Wire.endTransmission() != 0) {
      Serial.println(F("NOT FOUND"));
      continue;
    }
    Serial.println(F("found"));
    
    // ---- ERASE all 16 pages via register addr 0x00 ----
    Serial.print(F("  Erase: "));
    bool eraseOK = true;
    for (uint8_t page = 0; page < 16; page++) {
      uint8_t cmd = 0xC0 | page;
      Wire.beginTransmission(0x00);  // Register space
      Wire.write(0xE3);              // ERSE register
      Wire.write(cmd);               // Erase command + page
      uint8_t err = Wire.endTransmission();
      if (err != 0) {
        Serial.print(F("F"));
        Serial.print(page);
        Serial.print(F(" "));
        eraseOK = false;
      } else {
        Serial.print(F("."));
      }
      delay(50);
    }
    Serial.println(eraseOK ? F(" OK") : F(" PARTIAL"));
    
    // Quick check: read NVM page 8 to see if erased
    Wire.beginTransmission(0x01);
    Wire.write(0x80);
    Wire.endTransmission();
    Wire.requestFrom((uint8_t)0x01, (uint8_t)4);
    Serial.print(F("  Post-erase 0x80: "));
    for (int i = 0; i < 4; i++) {
      uint8_t b = Wire.available() ? Wire.read() : 0xEE;
      Serial.print(b, HEX);
      Serial.print(F(" "));
    }
    Serial.println();
    
    // ---- WRITE factory NVM ----
    Serial.print(F("  Write: "));
    bool writeOK = true;
    uint8_t pageBuf[16];
    
    for (uint8_t page = 0; page < 16; page++) {
      uint8_t nvmStart = page * 16;
      
      if (page < 7) {
        memset(pageBuf, 0, 16);
      } else {
        uint8_t off = (page - 7) * 16;
        for (uint8_t i = 0; i < 16; i++) {
          pageBuf[i] = pgm_read_byte(&fData[ch][off + i]);
        }
      }
      
      Wire.beginTransmission(0x01);  // NVM space
      Wire.write(nvmStart);
      for (uint8_t i = 0; i < 16; i++) {
        Wire.write(pageBuf[i]);
      }
      uint8_t err = Wire.endTransmission();
      if (err != 0) {
        Serial.print(F("F"));
        Serial.print(page);
        Serial.print(F(" "));
        writeOK = false;
      } else {
        Serial.print(F("."));
      }
      delay(25);
    }
    Serial.println(writeOK ? F(" OK") : F(" PARTIAL"));
    
    // ---- VERIFY pages 7-15 ----
    Serial.print(F("  Verify: "));
    int bad = 0;
    for (uint8_t page = 7; page < 16; page++) {
      Wire.beginTransmission(0x01);
      Wire.write(page * 16);
      Wire.endTransmission();
      Wire.requestFrom((uint8_t)0x01, (uint8_t)16);
      
      uint8_t off = (page - 7) * 16;
      for (uint8_t i = 0; i < 16; i++) {
        uint8_t got = Wire.available() ? Wire.read() : 0xEE;
        uint8_t exp = pgm_read_byte(&fData[ch][off + i]);
        if (got != exp) {
          bad++;
          if (bad <= 3) {
            Serial.print(F("\n    @0x"));
            Serial.print(page * 16 + i, HEX);
            Serial.print(F(": exp=0x"));
            Serial.print(exp, HEX);
            Serial.print(F(" got=0x"));
            Serial.print(got, HEX);
          }
        }
      }
    }
    
    if (bad == 0) {
      Serial.println(F("PERFECT!"));
      ok++;
    } else {
      Serial.print(F("\n  "));
      Serial.print(bad);
      Serial.println(F(" mismatches"));
    }
  }
  
  // Disable mux
  Wire.beginTransmission(MUX_ADDR);
  Wire.write(0);
  Wire.endTransmission();
  
  Serial.print(F("\nDone: "));
  Serial.print(ok);
  Serial.println(F("/6 restored."));
  Serial.println(F("POWER CYCLE board, then run channel_scanner."));
}

void loop() {}
