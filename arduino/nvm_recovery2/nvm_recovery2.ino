/*
 * SLG47004V NVM Recovery v2 — Prime_Maxel-v3
 * 
 * Simplified: only tries known address pairs.
 * After erase, chips shifted from 0x08 to 0x00.
 * NVM space shifted from 0x09 to 0x01.
 * 
 * Strategy: write factory NVM via NVM address (0x01 or 0x09),
 * use register address (0x00 or 0x08) for erase commands.
 */

#include <Wire.h>

#define MUX_ADDR  0x70

// Factory NVM data per channel (bytes 0x70-0xFF only, first 0x70 are zeros)
const uint8_t factory_ch0[] PROGMEM = {
  0x00,0x00,0x00,0x00,0x00,0x00,0x00,0x00,0x00,0x00,0x00,0x00,0x00,0x00,0x00,0x01,
  0xA5,0x20,0x20,0x18,0x22,0xC4,0x19,0x02,0x18,0x01,0xC8,0x31,0x00,0xC0,0x08,0x00,
  0x00,0x00,0x00,0x00,0x00,0x00,0x00,0x00,0x00,0x00,0x00,0x00,0x00,0x00,0x00,0x00,
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  0x5A,0x00,0x00,0x01,0x10,0x00,0x00,0xFF,0xFF,0x41,0x0F,0x10,0x30,0x10,0x12,0x00
};
const uint8_t factory_ch1[] PROGMEM = {
  0x00,0x00,0x00,0x00,0x00,0x00,0x00,0x00,0x00,0x00,0x00,0x00,0x00,0x00,0x00,0x01,
  0xA5,0x22,0x21,0x18,0x44,0x00,0x23,0x80,0x38,0xC0,0x00,0x38,0xC0,0x80,0x60,0x31,
  0x00,0x00,0x00,0x00,0x00,0x00,0x00,0x00,0x00,0x00,0x00,0x00,0x00,0x00,0x00,0x00,
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  0x5A,0x00,0x00,0x01,0x10,0x00,0x00,0xFF,0xFF,0x3E,0x0E,0x01,0x30,0x00,0x15,0x00
};
const uint8_t factory_ch2[] PROGMEM = {
  0x00,0x00,0x00,0x00,0x00,0x00,0x00,0x00,0x00,0x00,0x00,0x00,0x00,0x00,0x00,0x01,
  0xA5,0x27,0x20,0x12,0x06,0x4E,0x68,0x80,0x10,0x04,0x08,0x30,0x00,0x3C,0xC6,0x31,
  0x00,0x00,0x00,0x00,0x00,0x00,0x00,0x00,0x00,0x00,0x00,0x00,0x00,0x00,0x00,0x00,
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  0x5A,0x00,0x00,0x01,0x10,0x00,0x00,0xFF,0xFF,0x41,0x10,0x10,0x30,0x10,0x12,0x00
};
const uint8_t factory_ch3[] PROGMEM = {
  0x00,0x00,0x00,0x00,0x00,0x00,0x00,0x00,0x00,0x00,0x00,0x00,0x00,0x00,0x00,0x01,
  0xA5,0x20,0x24,0x18,0x42,0x14,0x21,0x80,0x21,0x27,0x10,0x32,0x08,0x30,0x07,0x02,
  0x00,0x00,0x00,0x00,0x00,0x00,0x00,0x00,0x00,0x00,0x00,0x00,0x00,0x00,0x00,0x00,
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  0x5A,0x00,0x00,0x01,0x10,0x00,0x00,0xFF,0xFF,0x40,0x04,0x12,0x30,0x00,0x12,0x00
};
const uint8_t factory_ch4[] PROGMEM = {
  0x00,0x00,0x00,0x00,0x00,0x00,0x00,0x00,0x00,0x00,0x00,0x00,0x00,0x00,0x00,0x01,
  0xA5,0x29,0x24,0x18,0x00,0x0A,0x08,0x46,0x44,0x80,0xC0,0x30,0x10,0x40,0x81,0x31,
  0x00,0x00,0x00,0x00,0x00,0x00,0x00,0x00,0x00,0x00,0x00,0x00,0x00,0x00,0x00,0x00,
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  0x5A,0x00,0x00,0x01,0x10,0x00,0x00,0xFF,0xFF,0x40,0x10,0x12,0x30,0x06,0x10,0x00
};
const uint8_t factory_ch5[] PROGMEM = {
  0x00,0x00,0x00,0x00,0x00,0x00,0x00,0x00,0x00,0x00,0x00,0x00,0x00,0x00,0x00,0x01,
  0xA5,0x28,0x23,0x10,0x01,0x20,0x12,0x00,0x00,0x20,0x00,0x39,0xF0,0xAC,0x03,0x00,
  0x00,0x00,0x00,0x00,0x00,0x00,0x00,0x00,0x00,0x00,0x00,0x00,0x00,0x00,0x00,0x00,
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  0x5A,0x00,0x00,0x01,0x10,0x00,0x00,0xFF,0xFF,0x40,0x10,0x12,0x30,0x01,0x10,0x00
};

const uint8_t* factoryData[6] = {
  factory_ch0, factory_ch1, factory_ch2,
  factory_ch3, factory_ch4, factory_ch5
};

#define FACTORY_OFFSET 0x70   // Factory data starts at NVM byte 0x70
#define FACTORY_LEN    144    // 0x70 to 0xFF = 144 bytes = 9 pages

uint8_t regAddr[6];
uint8_t nvmAddr[6];
bool found[6];

void selectMux(uint8_t ch) {
  Wire.beginTransmission(MUX_ADDR);
  Wire.write(1 << ch);
  Wire.endTransmission();
  delay(5);
}

bool probe(uint8_t addr) {
  if (addr == 0) return false;  // Skip general call address
  Wire.beginTransmission(addr);
  return (Wire.endTransmission() == 0);
}

void setup() {
  Wire.begin();
  Wire.setWireTimeout(3000, true);  // 3ms timeout, reset on timeout
  Serial.begin(9600);
  while (!Serial);
  
  Serial.println(F("=== SLG47004V NVM Recovery v2 ==="));
  Serial.println();
  
  // Phase 1: Quick scan — only try known addresses
  Serial.println(F("Scanning (old=0x08, shifted=0x01)..."));
  int totalFound = 0;
  
  for (uint8_t ch = 0; ch < 6; ch++) {
    selectMux(ch);
    found[ch] = false;
    
    Serial.print(F("  Ch "));
    Serial.print(ch);
    Serial.print(F(": "));
    
    // Try factory address first (0x08 reg, 0x09 nvm)
    if (probe(0x08)) {
      regAddr[ch] = 0x08;
      nvmAddr[ch] = 0x09;
      found[ch] = true;
      Serial.println(F("0x08 (factory)"));
    }
    // Try shifted address (0x01 nvm — we know this responded)
    else if (probe(0x01)) {
      regAddr[ch] = 0x00;  // Register space at 0x00
      nvmAddr[ch] = 0x01;  // NVM at 0x01
      found[ch] = true;
      Serial.println(F("0x01 (shifted)"));
    }
    // Try other common addresses
    else if (probe(0x02)) {
      regAddr[ch] = 0x00;
      nvmAddr[ch] = 0x01;
      found[ch] = true;
      Serial.println(F("0x02 found (using 0x01 for NVM)"));
    }
    else {
      Serial.println(F("NOT FOUND"));
    }
    
    if (found[ch]) totalFound++;
  }
  
  // Disable mux
  Wire.beginTransmission(MUX_ADDR);
  Wire.write(0);
  Wire.endTransmission();
  
  Serial.println();
  Serial.print(totalFound);
  Serial.println(F("/6 found"));
  
  if (totalFound == 0) {
    Serial.println(F("No chips! Power cycle board (unplug 10s)."));
    return;
  }
  
  // Phase 2: Restore
  Serial.println();
  Serial.println(F("Send 'R' to restore factory NVM."));
  
  while (!Serial.available());
  if (Serial.read() != 'R') {
    Serial.println(F("Aborted."));
    return;
  }
  
  Serial.println(F("Restoring..."));
  Serial.println();
  
  int ok = 0;
  
  for (uint8_t ch = 0; ch < 6; ch++) {
    if (!found[ch]) continue;
    selectMux(ch);
    
    Serial.print(F("Ch "));
    Serial.print(ch);
    Serial.print(F(" (nvm=0x"));
    Serial.print(nvmAddr[ch], HEX);
    Serial.println(F("):"));
    
    // Erase: for shifted chips (reg=0x00), we can't easily send
    // erase cmd to addr 0. Try writing NVM directly — NVM write
    // overwrites after erase. Try page-by-page erase+write.
    
    uint8_t pageBuf[16];
    bool allOK = true;
    
    for (uint8_t page = 0; page < 16; page++) {
      uint8_t nvmStart = page * 16;
      
      // Try erase if we can access register space
      if (regAddr[ch] != 0x00) {
        uint8_t eraseCmd = 0xC0 | page;
        Wire.beginTransmission(regAddr[ch]);
        Wire.write(0xE3);
        Wire.write(eraseCmd);
        Wire.endTransmission();
        delay(50);
      }
      
      // Prepare page data
      if (page < 7) {
        // Pages 0-6: all zeros
        memset(pageBuf, 0, 16);
      } else {
        // Pages 7-15: from factory backup
        uint8_t offset = (page - 7) * 16;
        for (uint8_t i = 0; i < 16; i++) {
          pageBuf[i] = pgm_read_byte(&factoryData[ch][offset + i]);
        }
      }
      
      // Write page
      Wire.beginTransmission(nvmAddr[ch]);
      Wire.write(nvmStart);
      for (uint8_t i = 0; i < 16; i++) {
        Wire.write(pageBuf[i]);
      }
      uint8_t err = Wire.endTransmission();
      delay(25);
      
      if (err != 0) {
        Serial.print(F("  Write FAIL page "));
        Serial.println(page);
        allOK = false;
      }
    }
    
    // Verify critical pages (7-15)
    Serial.print(F("  Verify: "));
    int mismatches = 0;
    
    for (uint8_t page = 7; page < 16; page++) {
      Wire.beginTransmission(nvmAddr[ch]);
      Wire.write(page * 16);
      Wire.endTransmission();
      Wire.requestFrom(nvmAddr[ch], (uint8_t)16);
      
      uint8_t offset = (page - 7) * 16;
      for (uint8_t i = 0; i < 16; i++) {
        uint8_t got = Wire.available() ? Wire.read() : 0xEE;
        uint8_t exp = pgm_read_byte(&factoryData[ch][offset + i]);
        if (got != exp) {
          mismatches++;
          if (mismatches <= 3) {
            Serial.print(F("\n    @0x"));
            Serial.print(page * 16 + i, HEX);
            Serial.print(F(" exp="));
            Serial.print(exp, HEX);
            Serial.print(F(" got="));
            Serial.print(got, HEX);
          }
        }
      }
    }
    
    if (mismatches == 0) {
      Serial.println(F("OK!"));
      ok++;
    } else {
      Serial.print(F("\n  "));
      Serial.print(mismatches);
      Serial.println(F(" mismatches"));
    }
    
    // Try reset (may fail for addr 0x00)
    if (regAddr[ch] != 0x00) {
      Wire.beginTransmission(regAddr[ch]);
      Wire.write(0x7B);
      Wire.write(0x01);
      Wire.endTransmission();
      delay(200);
      Serial.println(F("  Reset sent."));
    } else {
      Serial.println(F("  Skip reset (addr 0x00). Power cycle after."));
    }
    
    Serial.println();
  }
  
  Wire.beginTransmission(MUX_ADDR);
  Wire.write(0);
  Wire.endTransmission();
  
  Serial.print(F("Done: "));
  Serial.print(ok);
  Serial.println(F(" restored."));
  Serial.println(F("POWER CYCLE the board, then run channel_scanner."));
}

void loop() {}
